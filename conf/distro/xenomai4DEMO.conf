## conf/distro/xenomai4DEMO.conf
```bitbake
require conf/distro/poky.conf
DISTRO = "xenomai4DEMO"
DISTROOVERRIDES = "poky"
DISTRO_NAME = "X4-DEMO"
DISTRO_VERSION = "1.0-langdale"
DISTRO_CODENAME = "Scream of silence"
```

## conf/layer.conf
```bitbake
# We have a conf and classes directory, add to BBPATH
BBPATH .= ":${LAYERDIR}"

# We have recipes-* directories, add to BBFILES
BBFILES += "${LAYERDIR}/recipes-*/*/*.bb \
            ${LAYERDIR}/recipes-*/*/*.bbappend"

BBFILE_COLLECTIONS += "meta-xenomai-demo"
BBFILE_PATTERN_meta-xenomai-demo = "^${LAYERDIR}/"
BBFILE_PRIORITY_meta-xenomai-demo = "6"

LAYERDEPENDS_meta-xenomai-demo = "core"
LAYERSERIES_COMPAT_meta-xenomai-demo = "kirkstone langdale"
```
